## app/ProgrammableMatrix/sdkconfig.defaults
```kconfig
CONFIG_IDF_TARGET="esp32s3"
CONFIG_SPIRAM=y
CONFIG_SPIRAM_MODE_OCT=y
CONFIG_SPIRAM_SPEED_80M=y
CONFIG_SPIRAM_USE_MALLOC=y
CONFIG_BT_ENABLED=y
CONFIG_BT_BLUEDROID_ENABLED=y
CONFIG_BT_BLE_ENABLED=y
# BLE provisioning uses the legacy advertising APIs.
CONFIG_BT_BLE_42_FEATURES_SUPPORTED=y
CONFIG_BT_BLE_50_FEATURES_SUPPORTED=n
CONFIG_ESP_WIFI_STA_DISCONNECTED_PM_ENABLE=n
CONFIG_ESP_WIFI_SLP_DEFAULT_MIN_ACTIVE_TIME=50
CONFIG_ESP_MAIN_TASK_STACK_SIZE=8192
CONFIG_FREERTOS_HZ=1000
CONFIG_LOG_DEFAULT_LEVEL_INFO=y
CONFIG_ESP_PROTOCOMM_SUPPORT_SECURITY_VERSION_1=y
CONFIG_ESPTOOLPY_FLASHSIZE_16MB=y
# Reserve a 4MB application partition on the N16R8 board.
CONFIG_PARTITION_TABLE_CUSTOM=y
CONFIG_PARTITION_TABLE_CUSTOM_FILENAME="partitions.csv"
```

## app/espdl-quickapp/overlay/nuttx/arch/risc-v/src/esp32p4/Kconfig
```kconfig
#
# For a description of the syntax of this configuration file,
# see the file kconfig-language.txt in the NuttX tools repository.
#

if ARCH_CHIP_ESP32P4

config ESP32P4_PPA
	bool "Synchronous PPA SRM prototype"
	depends on BUILD_FLAT && ESP32P4_REV_MIN_FULL >= 300
	default n
	---help---
		Register /dev/ppa0 for UYVY to RGB565 scaling. This prototype
		serializes DMA2D with the native JPEG driver through the shared
		controller manager. Other DMA2D users must use that same manager.

config ESP32P4_JPEG
	bool "Synchronous JPEG hardware codec"
	depends on BUILD_FLAT && ESP32P4_REV_MIN_FULL >= 300
	default n
	---help---
		Register /dev/jpeg0 for bounded baseline JPEG decoding to RGB565,
		RGB888 or grayscale, and bounded JPEG encoding from RGB565, BGR888
		or grayscale. PPA and JPEG serialize the shared DMA2D reset
		domain and interrupt. Caller-owned RAM buffers remain exclusively
		owned by the ioctl until it returns. Progressive JPEG and unsupported
		profiles return errors before hardware is started.

source "arch/risc-v/src/common/espressif/Kconfig"

config ESP32P4_SELECTS_REV_LESS_V3
	bool "Select ESP32-P4 revisions <3.0 (No >=3.x Support)"
	default n
	---help---
		Select this option to support ESP32-P4 revisions 0.x and 1.x.
		Revisions higher than 3.0 (included) and revisions less than 3.0
		have huge hardware difference.
		Revisions higher than 3.0 (included) is not compatible with 0.x and 1.x.

choice ESP32P4_REV_MIN
	prompt "Minimum Supported ESP32-P4 Revision"
	default ESP32P4_REV_MIN_301
	---help---
		Required minimum chip revision. ESP-IDF will check for it and
		reject to boot if the chip revision fails the check.
		This ensures the chip used will have some modifications (features, or bugfixes).

		The complied binary will only support chips above this revision,
		this will also help to reduce binary size.

config ESP32P4_REV_MIN_0
	depends on ESP32P4_SELECTS_REV_LESS_V3
	bool "Rev v0.0"

config ESP32P4_REV_MIN_1
	depends on ESP32P4_SELECTS_REV_LESS_V3
	bool "Rev v0.1"

config ESP32P4_REV_MIN_100
	depends on ESP32P4_SELECTS_REV_LESS_V3
	bool "Rev v1.0"

config ESP32P4_REV_MIN_300
	bool "Rev v3.0"
	depends on !ESP32P4_SELECTS_REV_LESS_V3

config ESP32P4_REV_MIN_301
	bool "Rev v3.1"
	depends on !ESP32P4_SELECTS_REV_LESS_V3

endchoice # ESP32P4_REV_MIN

config ESP32P4_REV_MIN_FULL
	int
	default 0 if ESP32P4_REV_MIN_0
	default 1 if ESP32P4_REV_MIN_1
	default 100 if ESP32P4_REV_MIN_100
	default 300 if ESP32P4_REV_MIN_300
	default 301 if ESP32P4_REV_MIN_301

config ESP_REV_MIN_FULL
	int
	default ESP32P4_REV_MIN_FULL

config ESP32P4_REV_MAX_FULL
	int
	default 399 if !ESP32P4_SELECTS_REV_LESS_V3
	default 199 if ESP32P4_SELECTS_REV_LESS_V3

# keep in sync the "Maximum Supported Revision" description with this value

config ESP_REV_MAX_FULL
	int
	default ESP32P4_REV_MAX_FULL

config ESP_EFUSE_BLOCK_REV_MIN_FULL
	int "Minimum Supported ESP32-P4 eFuse Block Revision"
	default 0
	---help---
		Required minimum eFuse Block revision. ESP-IDF will check it at the 2nd bootloader stage
		whether the current image can work correctly for this eFuse Block revision.
		So that to avoid running an incompatible image on a SoC that contains breaking change in the eFuse Block.
		If you want to update this value to run the image that not compatible with the current eFuse Block revision,
		please contact to Espressif's business team for details:
		https://www.espressif.com.cn/en/contact-us/sales-questions

config ESP_EFUSE_BLOCK_REV_MAX_FULL
	int
	default 199
	comment "Maximum Supported ESP32-P4 eFuse Block Revision (eFuse Block Rev v0.99)"

# The revision in the comment must correspond to the default value of ESP_EFUSE_BLOCK_REV_MAX_FULL

menu "Cache config"

choice ESPRESSIF_CACHE_L2_CACHE_SIZE_SELECT
	prompt "L2 cache size"
	default ESPRESSIF_CACHE_L2_CACHE_256KB
	---help---
		L2 cache size to be set on application startup.

config ESPRESSIF_CACHE_L2_CACHE_128KB
	bool "128KB"

config ESPRESSIF_CACHE_L2_CACHE_256KB
	bool "256KB"

config ESPRESSIF_CACHE_L2_CACHE_512KB
	bool "512KB"

endchoice # ESPRESSIF_CACHE_L2_CACHE_SIZE_SELECT

config ESPRESSIF_CACHE_L2_CACHE_SIZE
	hex
	default 0x20000 if ESPRESSIF_CACHE_L2_CACHE_128KB
	default 0x40000 if ESPRESSIF_CACHE_L2_CACHE_256KB
	default 0x80000 if ESPRESSIF_CACHE_L2_CACHE_512KB

choice ESPRESSIF_CACHE_L2_CACHE_LINE_SIZE_SELECT
	prompt "L2 cache line size"
	default ESPRESSIF_CACHE_L2_CACHE_LINE_64B if ESPRESSIF_CACHE_L2_CACHE_128KB
	default ESPRESSIF_CACHE_L2_CACHE_LINE_64B if ESPRESSIF_CACHE_L2_CACHE_256KB
	default ESPRESSIF_CACHE_L2_CACHE_LINE_128B if ESPRESSIF_CACHE_L2_CACHE_512KB
	---help---
		L2 cache line size to be set on application startup.

config ESPRESSIF_CACHE_L2_CACHE_LINE_64B
	bool "64 Bytes"
	depends on ESPRESSIF_CACHE_L2_CACHE_128KB || ESPRESSIF_CACHE_L2_CACHE_256KB

config ESPRESSIF_CACHE_L2_CACHE_LINE_128B
	bool "128 Bytes"

endchoice # ESPRESSIF_CACHE_L2_CACHE_LINE_SIZE_SELECT

config ESPRESSIF_CACHE_L2_CACHE_LINE_SIZE
	int
	default 64 if ESPRESSIF_CACHE_L2_CACHE_LINE_64B
	default 128 if ESPRESSIF_CACHE_L2_CACHE_LINE_128B

config ESPRESSIF_CACHE_L1_CACHE_LINE_SIZE
	int
	default 64

endmenu # Cache config

menu "SD/MMC and SDIO Configuration"

config ESP32P4_SDMMC
	bool "ESP32-P4 SD/MMC host driver"
	select ARCH_HAVE_SDIO
	select MMCSD
	select MMCSD_SDIO
	select SDIO_BLOCKSETUP
	select SCHED_WORKQUEUE
	select SCHED_HPWORK
	default n
	---help---
		Enable the native NuttX driver for the ESP32-P4 SDMMC host.
		Slot 1 supports GPIO-matrix routing and is used by the on-board
		ESP32-C6 wireless co-processor.

config ESP32P4_SDMMC_DMA
	bool "Use internal DMA for SD/MMC transfers"
	depends on ESP32P4_SDMMC
	select SDIO_DMA
	default n

config ESP32P4_SDMMC_CMD
	int "CMD GPIO"
	depends on ESP32P4_SDMMC
	default 19

config ESP32P4_SDMMC_CLK
	int "CLK GPIO"
	depends on ESP32P4_SDMMC
	default 18

config ESP32P4_SDMMC_D0
	int "D0 GPIO"
	depends on ESP32P4_SDMMC
	default 14

config ESP32P4_SDMMC_D1
	int "D1 GPIO"
	depends on ESP32P4_SDMMC && !SDIO_WIDTH_D1_ONLY
	default 15

config ESP32P4_SDMMC_D2
	int "D2 GPIO"
	depends on ESP32P4_SDMMC && !SDIO_WIDTH_D1_ONLY
	default 16

config ESP32P4_SDMMC_D3
	int "D3 GPIO"
	depends on ESP32P4_SDMMC && !SDIO_WIDTH_D1_ONLY
	default 17

endmenu # SD/MMC and SDIO Configuration

endif # ARCH_CHIP_ESP32P4

config P4_REV3_MSPI_CRASH_AFTER_POWER_UP_WORKAROUND
	bool
	default y if ESP32P4_REV_MIN_FULL >= 300

config P4_REV3_MSPI_WORKAROUND_SIZE
	hex
	default 0x100 if ESP32P4_REV_MIN_FULL >= 300
	default 0

config ESP32P4_CAMERA_USB
	bool "USB 2.0 UVC camera host (CherryUSB DWC2)"
	default n
	help
		P4 HS host, UVC MJPEG capture, hotplug inventory and camera switching.
		Uses the dedicated OTG HS port; USB Serial/JTAG stays on its own PHY.

config ESP32P4_FLASH_AUTO_SUSPEND
	bool
	depends on n
	default n
	---help---
		Rejected experiment: the measured C84018 board suffered a PSRAM
		store bus fault during Bot/history writes with this option enabled.
		A driver capability flag and a successful build do not qualify this
		configuration for deployment. Keep the original cache protection.

config ESP32P4_DSI_FLASH_RELOAD
	bool
	depends on n
	default n
	help
		Rejected experiment: autonomous cache-on scanout passed, but the
		physical USB/Flash test still flickered and writes became slow.
		Retain only for reproduction, never enable in normal firmware.
```

## firmware/历史测试固件/esp32p4-camera-preview-v1.0/defconfig
```kconfig
#
# ESP32-P4 Function EV Board v1.0 autonomous LVGL touch desktop
#
# v1.0 uses the pre-v3 memory/linker layout and keeps UART0 available for
# diagnostics while desktop_main owns the LCD UI.
#
# CONFIG_ESPRESSIF_SPIRAM_MEMTEST is not set
# CONFIG_LV_BUILD_EXAMPLES is not set
# CONFIG_NSH_ARGCAT is not set
# CONFIG_NSH_CMDOPT_HEXDUMP is not set
CONFIG_ARCH="risc-v"
CONFIG_ARCH_BOARD="esp32p4-function-ev-board"
CONFIG_ARCH_BOARD_COMMON=y
CONFIG_ARCH_BOARD_ESP32P4_FUNCTION_EV_BOARD=y
CONFIG_ARCH_CHIP="esp32p4"
CONFIG_ARCH_CHIP_ESP32P4=y
CONFIG_ARCH_INTERRUPTSTACK=2048
CONFIG_ARCH_IRQ_TO_NDX=y
CONFIG_ARCH_MINIMAL_VECTORTABLE_DYNAMIC=y
CONFIG_ARCH_NUSER_INTERRUPTS=17
CONFIG_ARCH_RISCV=y
CONFIG_BOARDCTL_RESET=y
CONFIG_BOARD_LOOPSPERMSEC=15000
CONFIG_BUILTIN=y
CONFIG_DEBUG_FEATURES=y
CONFIG_DEBUG_MM=y
CONFIG_ESP32P4_FUNCTION_EV_BOARD_LCD=y
CONFIG_ESP32P4_FUNCTION_EV_BOARD_TOUCHSCREEN=y
CONFIG_ESP32P4_REV_MIN_100=y
CONFIG_ESP32P4_SELECTS_REV_LESS_V3=y
CONFIG_ESPRESSIF_CPU_FREQ_180=y
CONFIG_ESPRESSIF_EMAC=y
CONFIG_ESPRESSIF_ETH_DMA_BUFFER_SIZE=512
CONFIG_ESPRESSIF_ETH_NRXDESC=8
CONFIG_ESPRESSIF_ETH_NTXDESC=8
CONFIG_ESPRESSIF_FLASH_16M=y
CONFIG_ESPRESSIF_I2C0_SCLPIN=8
CONFIG_ESPRESSIF_I2C0_SDAPIN=7
CONFIG_ESPRESSIF_MIPI_CSI=y
CONFIG_ESPRESSIF_SPIRAM=y
CONFIG_ESPRESSIF_SPIRAM_SPEED_80M=y
CONFIG_EXPERIMENTAL=y
CONFIG_FS_PROCFS=y
CONFIG_FS_TMPFS=y
CONFIG_GRAPHICS_LVGL=y
CONFIG_HA_PANEL=y
CONFIG_IDLETHREAD_STACKSIZE=2048
CONFIG_INIT_ENTRYNAME="ha_panel_main"
CONFIG_INIT_ENTRYPOINT="desktop_main"
CONFIG_INIT_STACKSIZE=32768
CONFIG_INPUT_GT9XX_X_INVERT_MAX=1024
CONFIG_INPUT_GT9XX_Y_INVERT_MAX=600
CONFIG_INTELHEX_BINARY=y
CONFIG_INTERPRETERS_QUICKJS=y
CONFIG_LIBC_MEMFD_ERROR=y
CONFIG_LIBC_PERROR_STDOUT=y
CONFIG_LIBC_STRERROR=y
CONFIG_LIBM=y
CONFIG_LV_FONT_MONTSERRAT_24=y
CONFIG_LV_FONT_MONTSERRAT_48=y
CONFIG_LV_USE_CLIB_MALLOC=y
CONFIG_LV_USE_CLIB_SPRINTF=y
CONFIG_LV_USE_CLIB_STRING=y
CONFIG_LV_USE_NUTTX=y
CONFIG_LV_USE_NUTTX_TOUCHSCREEN=y
CONFIG_LV_USE_TINY_TTF=y
CONFIG_MM_BACKTRACE=0
CONFIG_MM_DUMP_ON_FAILURE=y
CONFIG_MM_KERNEL_HEAP=y
CONFIG_MM_KERNEL_HEAPSIZE=131072
CONFIG_MM_REGIONS=3
CONFIG_NETDB_DNSCLIENT=y
CONFIG_NETDEV_LATEINIT=y
CONFIG_NETDEV_PHY_IOCTL=y
CONFIG_NETINIT_DHCPC=y
CONFIG_NETINIT_DNS=y
CONFIG_NETINIT_THREAD=y
CONFIG_NETUTILS_DHCPC=y
CONFIG_NET_ETH_PKTSIZE=1514
CONFIG_NET_TCP=y
CONFIG_NET_UDP=y
CONFIG_NSH_BUILTIN_APPS=y
CONFIG_NSH_FILEIOSIZE=512
CONFIG_NSH_READLINE=y
CONFIG_NSH_STRERROR=y
CONFIG_NXCAMERA_LOOPTHREAD_STACKSIZE=8192
CONFIG_NXCAMERA_MAINTHREAD_STACKSIZE=4096
CONFIG_PREALLOC_TIMERS=0
CONFIG_RR_INTERVAL=200
CONFIG_SCHED_BACKTRACE=y
CONFIG_SCHED_WAITPID=y
CONFIG_START_DAY=29
CONFIG_START_MONTH=11
CONFIG_START_YEAR=2019
CONFIG_SYSTEM_DESKTOP=y
CONFIG_SYSTEM_DUMPSTACK=y
CONFIG_SYSTEM_NSH=y
CONFIG_SYSTEM_NXCAMERA=y
CONFIG_UART0_SERIAL_CONSOLE=y
```
